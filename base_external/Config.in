## base_external/Config.in
```kconfig
menu "project_base packages install"

	source "$BR2_EXTERNAL_project_base_PATH/package/aesd-assignments/Config.in"
endmenu
```

## base_external/package/ldd/Config.in
```kconfig
config BR2_PACKAGE_LDD
        bool "ldd"
        help
          Includes the modules included in misc-modules and scull folder of ldd3 respository in the kernel image.
          Used to understand buildroot external trees and package builds.
```
